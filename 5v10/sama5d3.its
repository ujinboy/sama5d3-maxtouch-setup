## 5v10/sama5d3.its
```
/dts-v1/;

/ {
	description = "Microchip SAMA5D3 Xplained FIT Image";
	#address-cells = <1>;

	images {
		kernel {
			description = "Linux4SAM Linux kernel";
			data = /incbin/("zImage");
			type = "kernel";
			arch = "arm";
			os = "linux";
			compression = "none";
			load = <0x22000000>;
			entry = <0x22000000>;
			hash-1 { algo = "crc32"; };
			hash-2 { algo = "sha1"; };
		};

		base_fdt {
			description = "Flattened Device Tree blob";
			data = /incbin/("at91-sama5d3_xplained.dtb");
			type = "flat_dt";
			arch = "arm";
			compression = "none";
			load = <0x23000000>;
			hash-1 { algo = "crc32"; };
			hash-2 { algo = "sha1"; };
		};
	};

	configurations {
		default = "kernel_dtb";

		kernel_dtb {
			description = "Linux kernel and base FDT blob for SAMA5D3_XPLAINED board";
			kernel = "kernel";
			fdt = "base_fdt";
		};

		base_dtb {
			description = "FDT blob for base SAMA5D3_XPLAINED board";
			fdt = "base_fdt";
		};
	};
};
```
